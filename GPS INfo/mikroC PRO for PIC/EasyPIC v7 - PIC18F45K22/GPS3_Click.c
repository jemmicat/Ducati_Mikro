/*
 * Project name:
     GPS3 Click board example
 * Copyright:
     (c) mikroElektronika, 2014.
 * Revision History:
     20121218:
       - initial release (MP)
 * Description:
     This example demonstrates the functionality of the GPS3 Click board.
     It displays a map of the world on the Glcd and shows the location of the GPS module on it.
 * Test configuration:
     MCU:             PIC18F45K22
                      http://ww1.microchip.com/downloads/en/DeviceDoc/41412F.pdf
     Dev.Board:       EasyPIC7
                      http://www.mikroe.com/easypic/
     Oscillator:      HS-PLL 32.0000 MHz, 8.0000 MHz Crystal
     Ext. Modules:    GPS3 Click -    ac:GPS3_Click

     SW:              mikroC PRO for PIC
                      http://www.mikroe.com/mikroc/pic/
 * NOTES:
     - Place GPS3 Click board in the mikroBUS socket 1 on the EasyPIC7 board.
     - Turn on GLCD backlight switch SW.4.6. (board specific)
 */

#include "World Map.h"

sbit RST at RE1_bit;
sbit RST_Direction at TRISE.B1;

// Variables used in the example
char txt[768];
char *string;
int i, latitude, longitude;
char mapShown;
unsigned short ready;

// Glcd module connections
char GLCD_DataPort at PORTD;
sbit GLCD_CS1 at LATB0_bit;
sbit GLCD_CS2 at LATB1_bit;
sbit GLCD_RS  at LATB2_bit;
sbit GLCD_RW  at LATB3_bit;
sbit GLCD_EN  at LATB4_bit;
sbit GLCD_RST at LATB5_bit;

sbit GLCD_CS1_Direction at TRISB0_bit;
sbit GLCD_CS2_Direction at TRISB1_bit;
sbit GLCD_RS_Direction  at TRISB2_bit;
sbit GLCD_RW_Direction  at TRISB3_bit;
sbit GLCD_EN_Direction  at TRISB4_bit;
sbit GLCD_RST_Direction at TRISB5_bit;
// End of Glcd module connections

void interrupt() {
  if (RCIF_bit == 1) {             // If interrupt is generated by RCIF
    txt[i] = UART1_Read();         // Read data and store it to txrt string
    i++;                           // Increment string index
    if (i == 768) {                // If index = 768,
      i = 0;                       //   set it to zero
    ready = 1;                     // Ready for parsing GPS data
  }
  RCIF_bit = 0;                    // Set RCIF to 0
  }
}

void Display_Cursor(signed int lat, signed int lon) {
  unsigned int latitude_y, longitude_x;

  // Latitude and Longitude scaling for 128x64 display:
  // Latitude: Input range is -90 to 90 degrees
  // Longitude: Input range is -180 to 180 degrees
  latitude_y = ((61*(90 - lat))/180) + 1;
  longitude_x = (lon +180) * 125;
  longitude_x = longitude_x/360 + 1;

  // Cursor drawing:
  Glcd_Dot(longitude_x,latitude_y,2);       // Center dot
  Glcd_Dot(longitude_x-1,latitude_y,2);     // Left dot
  Glcd_Dot(longitude_x+1,latitude_y,2);     // Right dot
  Glcd_Dot(longitude_x,latitude_y-1,2);     // Upper dot
  Glcd_Dot(longitude_x,latitude_y+1,2);     // Lower dot
}

void main() {
                                   //
  ANSELA = 0;                      // Configure ports as digital I/O
  ANSELC = 0;                      //
  ANSELD = 0;                      //
  ANSELE = 0;

  RST_Direction = 0;               // Set RST pin as output

  RST = 0;
  Delay_ms(100);                   // Pulldown RST pin at least 10ms
  RST = 1;

  Glcd_Init();                     // Initialize GLCD
  Glcd_Fill(0x00);                 // Clear display

  mapShown = 0;                    //
  ready = 0;                       // Initialize variables
  i = 0;                           //

  UART1_Init(9600);                // Initialize UART module at 9600

  RC1IE_bit = 1;                   // Enable USART Receiver interrupt
  GIE_bit = 1;                     // Enable Global interrupt
  PEIE_bit = 1;                    // Enable Peripheral interrupt

  Glcd_Write_Text_Adv("Waiting for satellite FIX", 20, 28);

  while(1) {
    OERR1_bit = 0;                 // Set OERR to 0
    FERR1_bit = 0;                 // Set FERR to 0

    if(ready == 1) {               // If the data in txt array is ready do:
      ready = 0;
      string = strstr(txt,"$GPGGA");
      if(string != 0) {            // If txt array contains "$GPGGA" string we proceed...
        if(string[43] == '1') {    // If "$GPGGA" NMEA message have '1' sign in the 43-th
                                   // position it means that tha GPS receiver have FIXed position!
            latitude = (string[18]-48)*10 + (string[19]-48);
            longitude = (string[30]-48)*100 + (string[31]-48)*10 + (string[32]-48);
            if(string[28] == 'S') {           // if the latitude is in the South direction it has minus sign
              latitude = 0 - latitude;
            }
            if(string[41] == 'W') {           // if the longitude is in the West direction it has minus sign
              longitude = 0 - longitude;
            }
          if (!mapShown){
            Glcd_Image( World_bmp );             // Display World map on the GLCD
            mapShown = 1;
          }
          Display_Cursor(latitude, longitude);   // Display the cursor on the world map
        }
      }
    }
  }
}